## Kconfig
```kconfig
if BOARD_GIGABYTE_GA_Z77X_UD5H

config BOARD_SPECIFIC_OPTIONS
	def_bool y
	select ARCH_X86
	select CPU_INTEL_SOCKET_LGA1155
	select NORTHBRIDGE_INTEL_IVYBRIDGE
	select USE_NATIVE_RAMINIT
	select SOUTHBRIDGE_INTEL_C216
	select SUPERIO_ITE_IT8728F
	select BOARD_ROMSIZE_KB_8192
	select HAVE_ACPI_TABLES
	select HAVE_OPTION_TABLE
	select HAVE_CMOS_DEFAULT
	select HAVE_ACPI_RESUME
	select HAVE_SMI_HANDLER
	select INTEL_INT15
	select SERIRQ_CONTINUOUS_MODE
	select MAINBOARD_HAS_LIBGFXINIT
	select MAINBOARD_HAS_LPC_TPM
	select TPM

config DRAM_RESET_GATE_GPIO
	int
	default 25

config USBDEBUG_HCD_INDEX
	int
	default 2

config MAINBOARD_DIR
	string
	default gigabyte/ga-z77x-ud5h

config MAINBOARD_PART_NUMBER
	string
	default "GA-Z77X-UD5H"

config MAX_CPUS
	int
	default 8

config VGA_BIOS_ID
	string
	default "8086,0162"

config VGA_BIOS_FILE
	string
	default "pci8086,0162.rom"

config HAVE_IFD_BIN
	bool
	default n

config HAVE_ME_BIN
	bool
	default n

config HAVE_GBE_BIN
	bool
	default n

config IFD_BIOS_SECTION
	string
	default "0x00200000:0x007fffff"

config IFD_ME_SECTION
	string
	default "0x00003000:0x001fffff"

config IFD_GBE_SECTION
	string
	default "0x00001000:0x00002fff"

endif # BOARD_GIGABYTE_GA_Z77X_UD5H
```
